## Ion/Ion_defconfig
```kconfig
CONFIG_ARM_MPU=y
CONFIG_HW_STACK_PROTECTION=y

# Noke Stuff
CONFIG_NOKE_HEARTBEAT=y
CONFIG_NOKE_LEDS=y
CONFIG_NOKE_BUZZER=y
CONFIG_NOKE_MOTOR=y
CONFIG_NOKE_HALL=y
CONFIG_NOKE_UART_IPC=y
CONFIG_NOKE_NOKEBUS=y
```

## NDA_01/NDA_01_defconfig
```kconfig
CONFIG_ARM_MPU=y
CONFIG_HW_STACK_PROTECTION=y

# Noke Stuff
CONFIG_NOKE_HEARTBEAT=y
CONFIG_NOKE_ANT_CTL=y
```
