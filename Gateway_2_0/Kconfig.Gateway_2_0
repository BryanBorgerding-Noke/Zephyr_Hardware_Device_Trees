## INF600096/INF600096_nrf54l15_cpuapp_defconfig
```kconfig
CONFIG_ARM_MPU=y
CONFIG_HW_STACK_PROTECTION=y

CONFIG_NULL_POINTER_EXCEPTION_DETECTION_NONE=y

CONFIG_CACHE_MANAGEMENT=y
CONFIG_EXTERNAL_CACHE=y

CONFIG_NRF_GRTC_START_SYSCOUNTER=y

CONFIG_NRFX_TIMER0=n
CONFIG_NRFX_TIMER10=y

CONFIG_SHELL_BACKEND_SERIAL=n



# Noke stuff
CONFIG_NOKE_HEARTBEAT=y
CONFIG_NOKE_LEDS=y
CONFIG_NOKE_BUZZER=y
CONFIG_NOKE_MOTOR=y
CONFIG_NOKE_HALL=y
CONFIG_NOKE_TAMPER=y
CONFIG_NOKE_ADC=y
CONFIG_NOKE_ACCEL=y

CONFIG_SERIAL=y
CONFIG_NOKE_UART_IPC=y

# Gives shell command interface for debug
CONFIG_I2C_SHELL=n
```

## INF600096/Kconfig.INF600096
```kconfig
config BOARD_INF600096
	select SOC_NRF54L15_CPUAPP if BOARD_INF600096_NRF54L15_CPUAPP
	select SOC_NRF54L15_CPUFLPR if \
		BOARD_INF600096_NRF54L15_CPUFLPR || \
		BOARD_INF600096_NRF54L15_CPUFLPR_XIP
```

## INF600096/board.yml
```yaml
board:
  name: INF600096
  vendor: Noke
  socs:
  - name: nrf54l15
    variants:
    - name: xip
      cpucluster: cpuflpr
```

## INF600096_WP/INF600096_WP_defconfig
```kconfig
CONFIG_ARM_MPU=y
CONFIG_HW_STACK_PROTECTION=y

CONFIG_SERIAL=y
CONFIG_NOKE_UART_IPC=y
```

## IPM0000/IPM0000_defconfig
```kconfig
CONFIG_ARM_MPU=y
CONFIG_HW_STACK_PROTECTION=y


CONFIG_SHELL_BACKEND_SERIAL=n

CONFIG_NOKE_HEARTBEAT=y
CONFIG_NOKE_LEDS=y
CONFIG_NOKE_BUZZER=y
CONFIG_NOKE_TAMPER=y
CONFIG_NOKE_NOKEBUS=y
```
